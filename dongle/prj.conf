## CMakeLists.txt
```
#
# Copyright (c) 2018 Nordic Semiconductor
#
# SPDX-License-Identifier: LicenseRef-Nordic-5-Clause
#
cmake_minimum_required(VERSION 3.20.0)

find_package(Zephyr REQUIRED HINTS $ENV{ZEPHYR_BASE})
project(dongle)

set(OPUS_LIBRARY_ROOT ${CMAKE_CURRENT_LIST_DIR}/../lib CACHE PATH "Opus library root directory")
set(ENV{OPUS_LIBRARY_ROOT} $OPUS_LIBRARY_ROOT)

zephyr_link_libraries(-mfloat-abi=hard)
zephyr_link_libraries(-mfpu=fpv4-sp-d16 -ffunction-sections -fdata-sections -fno-strict-aliasing -mthumb -mabi=aapcs)


# NORDIC SDK APP START
target_sources(app PRIVATE 
    src/main.c
    # ../lib/adpcm_lib/dvi_adpcm.c
)
# NORDIC SDK APP END

target_sources_ifdef(CONFIG_BOARD_NRF54L15DK_NRF54L15_CPUAPP app PRIVATE
		src/audio_handle.c
)

target_sources_ifdef(CONFIG_BOARD_NRF52840DK_NRF52840 app PRIVATE
		src/usb_audio_handle.c
)

# zephyr_library_include_directories(../lib/adpcm_lib)
zephyr_include_directories(../lib/opus/opus_include/opus-1.2.1)
zephyr_include_directories(../lib/opus/opus_configuration)
target_link_libraries(app PRIVATE ${OPUS_LIBRARY_ROOT}/opus/opus_library/opus_lib.a)
```

## Kconfig
```
#
# Copyright (c) 2024 Nordic Semiconductor
#
# SPDX-License-Identifier: LicenseRef-Nordic-5-Clause
#

source "Kconfig.zephyr"

config BLE_DONGLE_APP_LOG_LEVEL
	int "Log level for the ESB PRX sample"
	default 4

config SUPPORT_OPUS_DECODER
	bool "wether the sample needs to decoder the audio packet with opus(8:1) algorithm"
	default y

config SETTINGS
	default y

config ZMS
	default y if (SOC_FLASH_NRF_RRAM || SOC_FLASH_NRF_MRAM)

config NVS
	default y if !(SOC_FLASH_NRF_RRAM || SOC_FLASH_NRF_MRAM)
```

## prj.conf
```kconfig
#
# Copyright (c) 2018 Nordic Semiconductor
#
# SPDX-License-Identifier: LicenseRef-Nordic-5-Clause
#

# Enable the UART driver
CONFIG_UART_ASYNC_API=y
CONFIG_NRFX_UARTE0=y
CONFIG_SERIAL=y
CONFIG_CONSOLE=y
CONFIG_UART_CONSOLE=y

# Enable the BLE stack with GATT Client configuration
CONFIG_BT=y
CONFIG_BT_CENTRAL=y
CONFIG_BT_SMP=y
CONFIG_BT_GATT_CLIENT=y
CONFIG_BT_PERIPHERAL=y
CONFIG_BT_DEVICE_NAME="ble_dongle"

# Enable the BLE modules from NCS
CONFIG_BT_NUS=y
CONFIG_BT_NUS_CLIENT=y
CONFIG_BT_SCAN=y
CONFIG_BT_SCAN_FILTER_ENABLE=y
CONFIG_BT_SCAN_UUID_CNT=1
CONFIG_BT_SCAN_ADDRESS_CNT=1
CONFIG_BT_GATT_DM=y
CONFIG_HEAP_MEM_POOL_SIZE=4096

#PERIPHERAL connnection parameter , CI=20ms
CONFIG_BT_PERIPHERAL_PREF_MIN_INT=20
CONFIG_BT_PERIPHERAL_PREF_MAX_INT=20
CONFIG_BT_PERIPHERAL_PREF_LATENCY=0
CONFIG_BT_PERIPHERAL_PREF_TIMEOUT=400

#enable multiple connections
CONFIG_BT_MAX_CONN=3
CONFIG_BT_MAX_PAIRED=3
CONFIG_BT_CONN_CTX=y

# update PHY to 2M
CONFIG_BT_USER_PHY_UPDATE=y
CONFIG_BT_CTLR_PHY_2M=y
CONFIG_BT_AUTO_PHY_UPDATE=y

# update MTU to 247
CONFIG_BT_USER_DATA_LEN_UPDATE=y
CONFIG_BT_CTLR_DATA_LENGTH_MAX=251
CONFIG_BT_BUF_ACL_RX_SIZE=251
CONFIG_BT_BUF_ACL_TX_SIZE=251
CONFIG_BT_L2CAP_TX_MTU=247
CONFIG_BT_BUF_EVT_RX_COUNT=11
CONFIG_BT_BUF_ACL_TX_COUNT=10
CONFIG_BT_ATT_TX_COUNT=10
CONFIG_BT_CONN_TX_MAX=10
CONFIG_BT_AUTO_DATA_LEN_UPDATE=y
CONFIG_BT_CTLR_SDC_MAX_CONN_EVENT_LEN_DEFAULT=10000

#
CONFIG_BT_RX_STACK_SIZE=4096


# This example requires more stack
CONFIG_SYSTEM_WORKQUEUE_STACK_SIZE=2048
# Enable bonding
CONFIG_BT_SETTINGS=y
CONFIG_FLASH=y
CONFIG_FLASH_PAGE_LAYOUT=y
CONFIG_FLASH_MAP=y

#net buf options
CONFIG_NET_BUF=y

CONFIG_FPU=y
CONFIG_PCM_MIX=y

# Enable DK LED and Buttons library
CONFIG_DK_LIBRARY=y

# Config logger
CONFIG_LOG=y
CONFIG_USE_SEGGER_RTT=n
CONFIG_LOG_BACKEND_RTT=n
CONFIG_LOG_BACKEND_UART=y
CONFIG_LOG_PRINTK=y

CONFIG_ASSERT=y
```

## boards/nrf52840dk_nrf52840.conf
```kconfig
#
# Copyright (c) 2019 Nordic Semiconductor ASA
#
# SPDX-License-Identifier: LicenseRef-Nordic-5-Clause
#

CONFIG_MAIN_STACK_SIZE=4096
CONFIG_SYSTEM_WORKQUEUE_STACK_SIZE=2048
CONFIG_USB_NRFX_WORK_QUEUE_STACK_SIZE=2048

#USB audio related configs
CONFIG_USB_DEVICE_AUDIO=y
CONFIG_RING_BUFFER=y
CONFIG_USB_DEVICE_STACK=y
CONFIG_USB_DEVICE_PRODUCT="Smart Remote dongle"
```

## boards/nrf54l15dk_nrf54l15_cpuapp.conf
```kconfig
#
# Copyright (c) 2024 Nordic Semiconductor
#
# SPDX-License-Identifier: LicenseRef-Nordic-5-Clause
#

# Disable the unsupported driver
CONFIG_NRFX_UARTE0=n

CONFIG_NRFX_UARTE20=y
# No need to decoder the audio packet as it will be transfer to BLE central directly
CONFIG_SUPPORT_OPUS_DECODER=n
```

## boards/nrf52840dk_nrf52840.overlay
```dts
// To get started, press Ctrl+Space to bring up the completion menu and view the available nodes.

// You can also use the buttons in the sidebar to perform actions on nodes.
// Actions currently available include:

// * Enabling / disabling the node
// * Adding the bus to a bus
// * Removing the node
// * Connecting ADC channels

// For more help, browse the DeviceTree documentation at https://docs.zephyrproject.org/latest/guides/dts/index.html
// You can also visit the nRF DeviceTree extension documentation at https://nrfconnect.github.io/vscode-nrf-connect/devicetree/nrfdevicetree.html
// / {
// 	chosen {
// 		nordic,nus-uart = &uart0;
// 	};
// };


&zephyr_udc0 {
	// hp_0 {
	// 	compatible = "usb-audio-hp";
	// 	feature-mute;
	// 	channel-l;
	// 	channel-r;
	// };
	mic_0 {
		compatible = "usb-audio-mic";
		sample-rate-hz = <16000>;
		feature-mute;
		channel-l;
		channel-r;
	};
};
```

## src/main.c
```c
/*
 * Copyright (c) 2018 Nordic Semiconductor ASA
 *
 * SPDX-License-Identifier: LicenseRef-Nordic-5-Clause
 */

/** @file
 *  @brief Nordic UART Service Client sample
 */

#include <errno.h>
#include <zephyr/kernel.h>
#include <zephyr/device.h>
#include <zephyr/devicetree.h>
#include <zephyr/drivers/gpio.h>
#include <zephyr/sys/byteorder.h>
#include <zephyr/sys/printk.h>
#include <zephyr/drivers/uart.h>
#include <dk_buttons_and_leds.h>
#include <zephyr/logging/log.h>

#include "main.h"
#include "ble_app.h"


LOG_MODULE_REGISTER(LOG_MODULE_NAME, CONFIG_BLE_DONGLE_APP_LOG_LEVEL);


#define FW_VERSION					"1.1.7"

static const struct gpio_dt_spec leds[] = {
	GPIO_DT_SPEC_GET(DT_ALIAS(led0), gpios),
	GPIO_DT_SPEC_GET(DT_ALIAS(led1), gpios),
	GPIO_DT_SPEC_GET(DT_ALIAS(led2), gpios),
	GPIO_DT_SPEC_GET(DT_ALIAS(led3), gpios),
};

/** The flag to switch microphone */
bool switch_mic_flag = true;

static int leds_init(void)
{
	if (!device_is_ready(leds[0].port)) {
		LOG_ERR("LEDs port not ready");
		return -ENODEV;
	}

	for (size_t i = 0; i < ARRAY_SIZE(leds); i++) {
		int err = gpio_pin_configure_dt(&leds[i], GPIO_OUTPUT);

		if (err) {
			LOG_ERR("Unable to configure LED%u, err %d.", i, err);
			return err;
		}

		gpio_pin_set(leds[i].port, leds[i].pin, 0);
	}

	return 0;
}


int leds_toggle(uint8_t idx) 
{
	gpio_pin_toggle(leds[idx].port, leds[idx].pin);

	return 0;
}


void set_led_on(uint8_t idx)
{
	gpio_pin_set(leds[idx].port, leds[idx].pin, 1);
}



static void button_changed(uint32_t button_state, uint32_t has_changed)
{
	uint32_t buttons = button_state & has_changed;

	if(buttons & KEY_MICROPHONE_SWITCH)
	{
		switch_mic_flag = !switch_mic_flag;
		LOG_INF("Button pressed at %d	 button_flag=0x%08X		switch_mic_flag=%d\n", k_cycle_get_32(), buttons, switch_mic_flag);
	}
}


static void configure_gpio(void)
{
	int err;

	err = dk_buttons_init(button_changed);
	if (err) {
		LOG_ERR("Cannot init buttons (err: %d)", err);
	}

	err = leds_init();
	if (err) {
		LOG_ERR("Cannot init LEDs (err: %d)", err);
	}
}


int main(void)
{
	int err;

	LOG_WRN("BLE dongle sample is running, the version is %s\n", FW_VERSION);

	configure_gpio();

	err = ble_app_init();
	if (err) {
		return 0;
	}

	// for (;;) {
	// 	for(uint8_t i = 0; i<4; i++)
	// 	{
	// 		// dk_set_led(i, (blink_status) % 2);
	// 		leds_toggle(i);
	// 	}

	// 	k_sleep(K_MSEC(RUN_LED_BLINK_INTERVAL));
	// }

}
```

## src/audio_handle.c
```c
#include <zephyr/kernel.h>
#include <zephyr/logging/log.h>
#include <zephyr/net_buf.h>
// #include <zephyr/usb/usb_device.h>
// #include <zephyr/usb/class/usb_audio.h>
#include <pcm_mix.h>

#include "audio_handle.h"
#include "main.h"
#include "ble_app.h"


LOG_MODULE_REGISTER(smart_dongle, CONFIG_BLE_DONGLE_APP_LOG_LEVEL);

#ifdef CONFIG_SUPPORT_OPUS_DECODER

#define AUDIO_HANDLE_STACK_SIZE        	30720
#define AUDIO_HANDLE_PRIORITY          	3

#define OPUS_DECODER_SIZE   			17944


K_MSGQ_DEFINE(audio_queue1, PCM_BLOCK_SIZE, PCM_BLOCK_COUNT, 4);
K_MSGQ_DEFINE(audio_queue2, PCM_BLOCK_SIZE, PCM_BLOCK_COUNT, 4);

/******************************** opus decoder variables ******************************************/
static uint8_t m_opus_channels   = CONFIG_OPUS_CHANNELS;
__ALIGN(4) static uint8_t m_opus_decoder[OPUS_DECODER_SIZE];
static OpusDecoder * const m_opus_decoder_state = (OpusDecoder *)m_opus_decoder;


K_MSGQ_DEFINE(m_msgq_rx_payloads, sizeof(struct audio_payload), 60, 4);



/*********************************opus decoder*********************************************/
static void opus_decoder_configure(void)
{
        printk("opus_decoder_get_size() = %d\n", opus_decoder_get_size(m_opus_channels));        
        __ASSERT_NO_MSG(opus_decoder_get_size(m_opus_channels) <= sizeof(m_opus_decoder));
        __ASSERT_NO_MSG(opus_decoder_init(m_opus_decoder_state, CONFIG_AUDIO_SAMPLING_FREQUENCY, m_opus_channels) == OPUS_OK);
}

void audio_buffer_handle(void)
{
    // int err = 0;
    struct audio_payload rx_payload;
	int16_t block_ptr[PCM_FRAME_BYTES];

	if(k_msgq_get(&m_msgq_rx_payloads, &rx_payload, K_FOREVER) == 0)
    {
		uint16_t pcm_index = 0;
		int frame_size = 0;
		uint8_t devID = rx_payload.dev_id;
		uint32_t packet_id = rx_payload.data[0] | (rx_payload.data[1] << 8) | (rx_payload.data[2] << 16) | (rx_payload.data[3] << 24);
        // LOG_INF("Packet received[%d] from %d, 0x%02x, 0x%02x, 0x%02x, 0x%02x  ", rx_payload.length,			
		// 		devID, rx_payload.data[0],rx_payload.data[1], rx_payload.data[2],rx_payload.data[3]);
		frame_size = opus_decode(m_opus_decoder_state, 
								&rx_payload.data[4], 
								CONFIG_AUDIO_FRAME_SIZE_BYTES, 
								block_ptr, 
								CONFIG_AUDIO_FRAME_SIZE_SAMPLES, 0);
																			
		LOG_INF("%d--%d", packet_id, frame_size);
	#if 1		
		/** send the PCM data to USB audio driver*/
		if(devID == 1)
		{
			while(pcm_index + FRAME_SIZE <= frame_size * 2) )
			{
				err = k_msgq_put(&audio_queue1, &block_ptr[pcm_index], K_NO_WAIT);
				if(!err)
				{
					pcm_index += FRAME_SIZE;
				}
				else
				{
					// LOG_ERR("[%d] Message sent error: %d", pcm_index, err);
					break;
				}
			}
			// LOG_INF("audio_queue1: %d", pcm_index);
		}
		else if(devID == 2)
		{	
			while(pcm_index + FRAME_SIZE <= frame_size * 2)
			{
				err = k_msgq_put(&audio_queue2, &block_ptr[pcm_index], K_NO_WAIT);			
				if(!err)
				{
					pcm_index += FRAME_SIZE;
				}
				else
				{
					// LOG_ERR("[%d] Message sent error: %d", pcm_index, err);
					break;
				}
			}
			// LOG_INF("audio_queue2: %d", pcm_index);
		}
		else
		{
			err = -EINVAL;
		}
				
		// if (err) {
		// 	LOG_ERR("Message sent error: %d", err);
		// }
	#endif
    } 
    else 
    {
        LOG_ERR("Error while reading esb rx packet");
    }
}

#else

#define AUDIO_HANDLE_STACK_SIZE        	4096
#define AUDIO_HANDLE_PRIORITY          	3

K_MSGQ_DEFINE(m_msgq_rx_payloads, sizeof(struct audio_payload), 60, 4);


void audio_buffer_handle(void)
{
    struct audio_payload rx_payload;

	if(k_msgq_get(&m_msgq_rx_payloads, &rx_payload, K_FOREVER) == 0)
    {
		// uint8_t devID = rx_payload.dev_id;
		// uint32_t packet_id = rx_payload.data[0] | (rx_payload.data[1] << 8) | (rx_payload.data[2] << 16) | (rx_payload.data[3] << 24);
        // LOG_INF("Packet[%d] received[%d] bytes from dev--%d \n", packet_id, rx_payload.length, devID);

		/** send the audio packet to ble central */
		bt_send_to_central((uint8_t *)&rx_payload, sizeof(rx_payload));
    } 
    else 
    {
        LOG_ERR("Error while reading esb rx packet");
    }
}

#endif

static void ble_audio_data_handle(void *, void *, void *)
{
#ifdef CONFIG_SUPPORT_OPUS_DECODER
	opus_decoder_configure();
	LOG_INF("opus enabled");
	// LOG_INF("mic_frame_size = %d\t ", usb_audio_get_in_frame_size(mic_dev));
#endif

    while(1)
    {
		audio_buffer_handle();
    }
}


K_THREAD_DEFINE(ble_audio_service, AUDIO_HANDLE_STACK_SIZE,
                ble_audio_data_handle, NULL, NULL, NULL,
                K_PRIO_PREEMPT(AUDIO_HANDLE_PRIORITY), 0, 0);
```

## src/audio_handle.h
```c
#ifndef __USB_AUDIO_APP_H__
#define __USB_AUDIO_APP_H__

#include <stdint.h>
#include "opus_application_config.h"
#include "opus.h"



#define MAX_SAMPLE_RATE             		16000
#define SAMPLE_BIT_WIDTH            		16
#define BYTES_PER_SAMPLE            		sizeof(int16_t)


#define USB_FRAME_SIZE_STEREO              (((MAX_SAMPLE_RATE * BYTES_PER_SAMPLE) / 1000) *2)

#define CONFIG_FIFO_FRAME_SPLIT_NUM         100


/* Size of a block for 1 ms of audio data. */
#define BLOCK_SIZE(_sample_rate, _number_of_ms) \
	(BYTES_PER_SAMPLE * (_sample_rate / 1000) * _number_of_ms)


#define PCM_BLOCK_SIZE				BLOCK_SIZE(MAX_SAMPLE_RATE, 2) 			// 1 ms
#define FRAME_SIZE                  ((MAX_SAMPLE_RATE / 1000) * 2)
#define PCM_FRAME_BYTES 			(CONFIG_AUDIO_FRAME_SIZE_SAMPLES * CONFIG_OPUS_CHANNELS)

#define PCM_BLOCK_COUNT             100

#define MAX_PAYLOAD_SIZE	(160 + 4) // 80 bytes for Opus payload + 4 bytes for packet ID


/** @brief Enhanced ShockBurst payload.
 *
 *  The payload is used both for transmissions and for acknowledging a
 *  received packet with a payload.
 */
struct audio_payload {
    uint8_t dev_id; /**< Device ID, used to identify the device that sent the packet. */
	uint8_t length; /**< Length of the packet when not in DPL mode. */
	uint8_t data[MAX_PAYLOAD_SIZE]; /**< The payload data and devID. */
};


extern struct k_msgq m_msgq_rx_payloads;


#endif
```

## src/ble_app.c
```c
#include <zephyr/kernel.h>
#include <zephyr/bluetooth/bluetooth.h>
#include <zephyr/bluetooth/hci.h>
#include <zephyr/bluetooth/conn.h>
#include <zephyr/bluetooth/uuid.h>
#include <zephyr/bluetooth/gatt.h>
#include <bluetooth/conn_ctx.h> 
#include <bluetooth/services/nus.h>
#include <bluetooth/services/nus_client.h>
#include <bluetooth/gatt_dm.h>
#include <bluetooth/scan.h>
#include <zephyr/settings/settings.h>
#include <zephyr/logging/log.h>

#include "main.h"
#include "ble_app.h"
#ifdef CONFIG_BOARD_NRF54L15DK_NRF54L15_CPUAPP
#include "audio_handle.h"
#else
#include "usb_audio_handle.h"
#endif

LOG_MODULE_DECLARE(LOG_MODULE_NAME);


BT_CONN_CTX_DEF(conns, CONFIG_BT_MAX_CONN, sizeof(struct bt_nus_client));

static struct k_work scan_work;

struct bt_conn *default_conn;
// static struct bt_nus_client nus_client;
static struct k_work adv_work;

static const struct bt_data ad[] = {
	BT_DATA_BYTES(BT_DATA_FLAGS, (BT_LE_AD_GENERAL | BT_LE_AD_NO_BREDR)),
	BT_DATA(BT_DATA_NAME_COMPLETE, DEVICE_NAME, DEVICE_NAME_LEN),
};

static const struct bt_data sd[] = {
	BT_DATA_BYTES(BT_DATA_UUID128_ALL, BT_UUID_NUS_VAL),
};

static void adv_work_handler(struct k_work *work)
{
	int err = bt_le_adv_start(BT_LE_ADV_CONN_FAST_2, ad, ARRAY_SIZE(ad), sd, ARRAY_SIZE(sd));

	if (err) {
		LOG_ERR("Advertising failed to start (err %d)\n", err);
		return;
	}

	LOG_INF("Advertising successfully started\n");
}

static void advertising_start(void)
{
	k_work_submit(&adv_work);
}



static uint8_t ble_data_received(struct bt_nus_client *nus,
						const uint8_t *data, uint16_t len)
{
	ARG_UNUSED(nus);
	static uint32_t timeCount1 = 0;
	static uint32_t timeCount2 = 0;
	uint8_t my_index = 99;		//invalid value

	my_index = bt_conn_index(nus->conn);
	// LOG_INF("dongle[%d] rec[%d]: 0x%02x, 0x%02x, 0x%02x, 0x%02x\n", my_index, len, data[0], data[1], data[2], data[3]);

	int ret = 0;
	static struct audio_payload rx_payload;

	if (len > MAX_PAYLOAD_SIZE) {
		LOG_ERR("Payload length %d exceeds maximum %d", len, MAX_PAYLOAD_SIZE);
		return -EMSGSIZE;
	}

	rx_payload.dev_id = my_index;

	if(rx_payload.dev_id == MIC_ID1) 	
	{
		if(0 == (timeCount1++ % 30))
			leds_toggle(MIC_LED1);
	}
	else if(rx_payload.dev_id == MIC_ID2) 		
	{
		if(0 == (timeCount2++ % 30))
			leds_toggle(MIC_LED2);
	}
		
	memcpy(rx_payload.data, data, len);
	rx_payload.length = len;
	ret = k_msgq_put(&m_msgq_rx_payloads, &rx_payload, K_NO_WAIT);
	if (ret)  {
		LOG_INF("Audio message queue is full");
		return -ENOMEM;
	}

	return BT_GATT_ITER_CONTINUE;
}

static void conn_cnt_foreach(struct bt_conn *conn, void *data)
{
	size_t *cur_cnt = data;

	(*cur_cnt)++;
}

static size_t count_conn(void)
{
	size_t conn_count = 0;

	bt_conn_foreach(BT_CONN_TYPE_LE, conn_cnt_foreach, &conn_count);
	__ASSERT_NO_MSG(conn_count <= CONFIG_BT_MAX_CONN);

	return conn_count;
}


static void discovery_complete(struct bt_gatt_dm *dm,
			       void *context)
{
	struct bt_nus_client *nus = context;

	bt_gatt_dm_data_print(dm);

	bt_nus_handles_assign(dm, nus);
	/** Enable notification */
	bt_nus_subscribe_receive(nus);

	bt_gatt_dm_data_release(dm);

	/*How many connections are there in the Connection Context Library?*/
	size_t num_nus_conns = count_conn();
	LOG_INF("Service discovery completed. num_nus_conns = %d\n", num_nus_conns);

	if(num_nus_conns < CONFIG_BT_MAX_CONN - 1)		//only support two peripherals
	{
		int err = bt_scan_start(BT_SCAN_TYPE_SCAN_ACTIVE);
		if (err) {
			LOG_ERR("Scanning failed to start (err %d)", err);
		} else {
			LOG_INF("Scanning started");
		}

		// (void)k_work_submit(&scan_work);
	}
	else
	{
		set_led_on(CON_STATUS_LED);
		advertising_start();
	}
}

static void discovery_service_not_found(struct bt_conn *conn,
					void *context)
{
	LOG_INF("Service not found");
}

static void discovery_error(struct bt_conn *conn,
			    int err,
			    void *context)
{
	LOG_WRN("Error while discovering GATT database: (%d)", err);
}

struct bt_gatt_dm_cb discovery_cb = {
	.completed         = discovery_complete,
	.service_not_found = discovery_service_not_found,
	.error_found       = discovery_error,
};

static void gatt_discover(struct bt_conn *conn)
{
	int err;

	struct bt_nus_client *nus_client = bt_conn_ctx_get(&conns_ctx_lib, conn);
	if (!nus_client) {
		return;
	}

	err = bt_gatt_dm_start(conn,
			       BT_UUID_NUS_SERVICE,
			       &discovery_cb,
			       nus_client);
	if (err) {
		LOG_ERR("could not start the discovery procedure, error "
			"code: %d", err);
	}

	bt_conn_ctx_release(&conns_ctx_lib, (void *) nus_client);
}

static void exchange_func(struct bt_conn *conn, uint8_t err, struct bt_gatt_exchange_params *params)
{
	if (!err) {
		uint16_t att_mtu = bt_gatt_get_mtu(conn);
        uint16_t payload = att_mtu - 3; /* ATT header */
        LOG_INF("MTU exchange successful: ATT MTU=%u, payload=%u\n", att_mtu, payload);
	} else {
		LOG_WRN("MTU exchange failed (err %" PRIu8 ")", err);
	}
}


static void connected(struct bt_conn *conn, uint8_t conn_err)
{
	char addr[BT_ADDR_LE_STR_LEN];
	struct bt_conn_info info;
	int err;

	bt_addr_le_to_str(bt_conn_get_dst(conn), addr, sizeof(addr));

	if (conn_err) {
		LOG_INF("Failed to connect to %s, 0x%02x %s", addr, conn_err,
			bt_hci_err_to_str(conn_err));

		if (default_conn == conn) {
			bt_conn_unref(default_conn);
			default_conn = NULL;

			(void)k_work_submit(&scan_work);
		}

		return;
	}

	LOG_INF("Connected: %s", addr);

#if 1
	/*Allocate memory for this connection using the connection context library. For reference,
	this code was taken from hids.c
	*/
	struct bt_nus_client *nus_client = bt_conn_ctx_alloc(&conns_ctx_lib, conn);
	if (!nus_client) {
		LOG_WRN("There is no free memory to allocate the connection context");
	}
	
	struct bt_nus_client_init_param init = {
		.cb = {
			.received = ble_data_received,
			// .sent = ble_data_sent,
		}
	};

	memset(nus_client, 0, bt_conn_ctx_block_size_get(&conns_ctx_lib));
	err = bt_nus_client_init(nus_client, &init);
	bt_conn_ctx_release(&conns_ctx_lib, (void *)nus_client);
	if (err) {
		LOG_ERR("NUS Client initialization failed (err %d)", err);
	}else{
		LOG_INF("NUS Client module initialized");
	}
#endif

	err = bt_conn_get_info(conn, &info);
	if (err) {
		LOG_ERR("Failed to get connection info (err %d)\n", err);
		return;
	}

	if (info.role == BT_CONN_ROLE_CENTRAL)
	{
		/** update MTU and security level */
		static struct bt_gatt_exchange_params exchange_params;
		exchange_params.func = exchange_func;
		err = bt_gatt_exchange_mtu(conn, &exchange_params);
		if (err) {
			LOG_WRN("MTU exchange failed (err %d)", err);
		}

		// err = bt_conn_set_security(conn, BT_SECURITY_L2);
		// if (err) {
		// 	LOG_WRN("Failed to set security: %d", err);
		// }
	
		gatt_discover(conn);

		err = bt_scan_stop();
		if ((!err) && (err != -EALREADY)) {
			LOG_ERR("Stop LE scan failed (err %d)", err);
		}
	}
	else
	{	
		default_conn = bt_conn_ref(conn);
		/*How many connections are there in the Connection Context Library?*/
		size_t num_nus_conns = count_conn();
		LOG_INF("slave been connected. num_nus_conns = %d\n", num_nus_conns);
	}
}

static void disconnected(struct bt_conn *conn, uint8_t reason)
{
	int err;
	char addr[BT_ADDR_LE_STR_LEN];

	bt_addr_le_to_str(bt_conn_get_dst(conn), addr, sizeof(addr));

	LOG_INF("Disconnected: %s, reason 0x%02x %s", addr, reason, bt_hci_err_to_str(reason));

	err = bt_conn_ctx_free(&conns_ctx_lib, conn);

	if(default_conn == conn)
	{
		bt_conn_unref(conn);
		default_conn = NULL;
	}
	
	(void)k_work_submit(&scan_work);
}

static void security_changed(struct bt_conn *conn, bt_security_t level,
			     enum bt_security_err err)
{
	char addr[BT_ADDR_LE_STR_LEN];

	bt_addr_le_to_str(bt_conn_get_dst(conn), addr, sizeof(addr));

	if (!err) {
		LOG_INF("Security changed: %s level %u", addr, level);
	} else {
		LOG_WRN("Security failed: %s level %u err %d %s", addr, level, err,
			bt_security_err_to_str(err));
	}

	gatt_discover(conn);
}


static void recycled_cb(void)
{
	LOG_INF("Connection object available from previous conn. Disconnect is complete!");
	if(default_conn)	//connection as slave has been disconnected
	{
		advertising_start();
	}
	else
	{
		(void)k_work_submit(&scan_work);
	}
}

static void on_le_phy_updated(struct bt_conn *conn, struct bt_conn_le_phy_info *param)
{
	// PHY Updated
	if (param->tx_phy == BT_CONN_LE_TX_POWER_PHY_1M) {
		LOG_INF("PHY updated. New PHY: 1M");
	}
	else if (param->tx_phy == BT_CONN_LE_TX_POWER_PHY_2M) {
		LOG_INF("PHY updated. New PHY: 2M");
	}
	else if (param->tx_phy == BT_CONN_LE_TX_POWER_PHY_CODED_S8) {
		LOG_INF("PHY updated. New PHY: Long Range");
	}
}

static void on_le_data_len_updated(struct bt_conn *conn, struct bt_conn_le_data_len_info *info)
{
	uint16_t tx_len     = info->tx_max_len; 
	uint16_t tx_time    = info->tx_max_time;
	uint16_t rx_len     = info->rx_max_len;
	uint16_t rx_time    = info->rx_max_time;
	LOG_INF("Data length updated. Length %d/%d bytes, time %d/%d us", tx_len, rx_len, tx_time, rx_time);
}


BT_CONN_CB_DEFINE(conn_callbacks) = {
	.connected = connected,
	.disconnected = disconnected,
	.security_changed = security_changed,
	.recycled         = recycled_cb,
	.le_phy_updated     = on_le_phy_updated,
	.le_data_len_updated    = on_le_data_len_updated,
};

static void scan_filter_match(struct bt_scan_device_info *device_info,
			      struct bt_scan_filter_match *filter_match,
			      bool connectable)
{
	char addr[BT_ADDR_LE_STR_LEN];

	bt_addr_le_to_str(device_info->recv_info->addr, addr, sizeof(addr));

	LOG_INF("Filters matched. Address: %s connectable: %d",
		addr, connectable);
}

static void scan_connecting_error(struct bt_scan_device_info *device_info)
{
	LOG_WRN("Connecting failed");
}

static void scan_connecting(struct bt_scan_device_info *device_info,
			    struct bt_conn *conn)
{
	default_conn = bt_conn_ref(conn);
}


BT_SCAN_CB_INIT(scan_cb, scan_filter_match, NULL,
		scan_connecting_error, scan_connecting);

static void try_add_address_filter(const struct bt_bond_info *info, void *user_data)
{
	int err;
	char addr[BT_ADDR_LE_STR_LEN];
	uint8_t *filter_mode = user_data;

	bt_addr_le_to_str(&info->addr, addr, sizeof(addr));

	struct bt_conn *conn = bt_conn_lookup_addr_le(BT_ID_DEFAULT, &info->addr);

	if (conn) {
		bt_conn_unref(conn);
		return;
	}

	err = bt_scan_filter_add(BT_SCAN_FILTER_TYPE_ADDR, &info->addr);
	if (err) {
		LOG_ERR("Address filter cannot be added (err %d): %s", err, addr);
		return;
	}

	LOG_INF("Address filter added: %s", addr);
	*filter_mode |= BT_SCAN_ADDR_FILTER;
}

static int scan_start(void)
{
	int err;
	uint8_t filter_mode = 0;

	err = bt_scan_stop();
	if (err) {
		LOG_ERR("Failed to stop scanning (err %d)", err);
		return err;
	}

	bt_scan_filter_remove_all();

	err = bt_scan_filter_add(BT_SCAN_FILTER_TYPE_UUID, BT_UUID_NUS_SERVICE);
	if (err) {
		LOG_ERR("UUID filter cannot be added (err %d", err);
		return err;
	}
	filter_mode |= BT_SCAN_UUID_FILTER;

	bt_foreach_bond(BT_ID_DEFAULT, try_add_address_filter, &filter_mode);

	err = bt_scan_filter_enable(filter_mode, false);
	if (err) {
		LOG_ERR("Filters cannot be turned on (err %d)", err);
		return err;
	}

	err = bt_scan_start(BT_SCAN_TYPE_SCAN_ACTIVE);
	if (err) {
		LOG_ERR("Scanning failed to start (err %d)", err);
		return err;
	}

	LOG_INF("Scan started");

	return 0;
}

static void scan_work_handler(struct k_work *item)
{
	ARG_UNUSED(item);

	(void)scan_start();
}

static void scan_init(void)
{
	struct bt_scan_init_param scan_init = {
		.connect_if_match = true,
		.conn_param = BT_LE_CONN_PARAM(12, 12, 0, 400),		//15ms CI
	};

	bt_scan_init(&scan_init);
	bt_scan_cb_register(&scan_cb);

	k_work_init(&scan_work, scan_work_handler);
	LOG_INF("Scan module initialized");
}

static void auth_cancel(struct bt_conn *conn)
{
	char addr[BT_ADDR_LE_STR_LEN];

	bt_addr_le_to_str(bt_conn_get_dst(conn), addr, sizeof(addr));

	LOG_INF("Pairing cancelled: %s", addr);
}

// static void pairing_confirm(struct bt_conn *conn)
// {
// 	char addr[BT_ADDR_LE_STR_LEN];

// 	bt_addr_le_to_str(bt_conn_get_dst(conn), addr, sizeof(addr));

// 	bt_conn_auth_pairing_confirm(conn);

// 	LOG_INF("Pairing confirmed: %s", addr);
// }

static void pairing_complete(struct bt_conn *conn, bool bonded)
{
	char addr[BT_ADDR_LE_STR_LEN];

	bt_addr_le_to_str(bt_conn_get_dst(conn), addr, sizeof(addr));

	LOG_INF("Pairing completed: %s, bonded: %d", addr, bonded);
}


static void pairing_failed(struct bt_conn *conn, enum bt_security_err reason)
{
	char addr[BT_ADDR_LE_STR_LEN];

	bt_addr_le_to_str(bt_conn_get_dst(conn), addr, sizeof(addr));

	LOG_WRN("Pairing failed conn: %s, reason %d %s", addr, reason,
		bt_security_err_to_str(reason));
}

static struct bt_conn_auth_cb conn_auth_callbacks = {
	.cancel = auth_cancel,
	// .pairing_confirm = pairing_confirm
};

static struct bt_conn_auth_info_cb conn_auth_info_callbacks = {
	.pairing_complete = pairing_complete,
	.pairing_failed = pairing_failed
};


int bt_send_to_central(const uint8_t *data, uint16_t len)
{
	if(default_conn)
	{
		int err = bt_nus_send(default_conn, data, len);
		if(err)
		{
			LOG_WRN("Failed to send data over BLE connection");
		}
		else 
		{
			uint8_t devID = data[0];
			uint8_t length = data[1];
			uint32_t packet_id = data[2] | (data[3] << 8) | (data[4] << 16) | (data[5] << 24);
			LOG_INF("Packet[%d] been sent[%d] bytes from dev--%d \n", packet_id, length, devID);
		}
		return err;
	}
	else
	{
		LOG_WRN("BLE connection has lost, need to reconnnect!!!");
		return -ENOTCONN;
	}	
}

int ble_app_init(void)
{
    int err = 0;

	err = bt_conn_auth_cb_register(&conn_auth_callbacks);
	if (err) {
		LOG_ERR("Failed to register authorization callbacks.");
		return err;
	}

	err = bt_conn_auth_info_cb_register(&conn_auth_info_callbacks);
	if (err) {
		printk("Failed to register authorization info callbacks.\n");
		return err;
	}

	err = bt_enable(NULL);
	if (err) {
		LOG_ERR("Bluetooth init failed (err %d)", err);
		return err;
	}
	LOG_INF("Bluetooth initialized");

	if (IS_ENABLED(CONFIG_SETTINGS)) {
		settings_load();
	}

	scan_init();
	err = scan_start();
	if (err) {
		return err;
	}

	LOG_WRN("Scanning started\n");

	k_work_init(&adv_work, adv_work_handler);
	// advertising_start();

    return 0;
}
```

## src/ble_app.h
```c
#ifndef __BLE_APP_H__
#define __BLE_APP_H__


#define DEVICE_NAME                     CONFIG_BT_DEVICE_NAME
#define DEVICE_NAME_LEN	                (sizeof(DEVICE_NAME) - 1)


int bt_send_to_central(const uint8_t *data, uint16_t len);

int ble_app_init(void);


#endif
```

## src/main.h
```c
#ifndef __MAIN_H__
#define __MAIN_H__

#include <dk_buttons_and_leds.h>


#define LOG_MODULE_NAME             dongle

#define RUN_LED_BLINK_INTERVAL          1000


/* UART payload buffer element size. */
#define UART_BUF_SIZE               20


#define MIC_LED1              		DK_LED1
#define MIC_LED2              		DK_LED2
#define USB_AUDIO_LED              	DK_LED3
#define CON_STATUS_LED              DK_LED4

#define MIC_ID1              		0
#define MIC_ID2              		1

#define KEY_MICROPHONE_SWITCH       DK_BTN1_MSK


extern bool switch_mic_flag;

extern int leds_toggle(uint8_t idx);

extern void set_led_on(uint8_t idx);


#endif
```

## src/usb_audio_handle.c
```c
#include <zephyr/kernel.h>
#include <zephyr/logging/log.h>
#include <zephyr/net_buf.h>
#include <zephyr/usb/usb_device.h>
#include <zephyr/usb/class/usb_audio.h>
#include <pcm_mix.h>

#include "audio_handle.h"
#include "main.h"


LOG_MODULE_REGISTER(smart_dongle, CONFIG_BLE_DONGLE_APP_LOG_LEVEL);


#define AUDIO_HANDLE_STACK_SIZE        	30720
#define AUDIO_HANDLE_PRIORITY          	3

#define OPUS_DECODER_SIZE   			17944


NET_BUF_POOL_FIXED_DEFINE(pool_out, CONFIG_FIFO_FRAME_SPLIT_NUM, USB_FRAME_SIZE_STEREO, 8, net_buf_destroy);

K_MSGQ_DEFINE(audio_queue1, PCM_BLOCK_SIZE, PCM_BLOCK_COUNT, 4);
K_MSGQ_DEFINE(audio_queue2, PCM_BLOCK_SIZE, PCM_BLOCK_COUNT, 4);

K_MSGQ_DEFINE(m_msgq_rx_payloads, sizeof(struct audio_payload), 60, 4);

static const struct device *const mic_dev = DEVICE_DT_GET_ONE(usb_audio_mic);

/******************************** opus decoder variables ******************************************/
static uint8_t m_opus_channels   = CONFIG_OPUS_CHANNELS;
__ALIGN(4) static uint8_t m_opus_decoder[OPUS_DECODER_SIZE];
static OpusDecoder * const m_opus_decoder_state = (OpusDecoder *)m_opus_decoder;


/*
* single channel transform to dual channels.
*
* @param[in] src_audio1 	Pointer to the single channel source pcm stream.
* @param[in] src_audio2 	Pointer to the second single channel source pcm stream (if needed).
*			 frames	   		Length of the stram buffer
*			 dst_audio		Pointer to the target dual channel pcm stream
*/
#if (CONFIG_OPUS_CHANNELS==1)
static void mono_to_stereo(int16_t* src_audio1, int16_t* src_audio2, int frames, int16_t* dst_audio) 
{
    for (int i = 0; i < frames; i++) 
    {
        dst_audio[2 * i] = src_audio1[i];
        dst_audio[2 * i + 1] = src_audio2[i];
    }
}
#endif

static void handle_audio_data(const struct device *dev)
{
	// LOG_INF("data were requested from the device and may be send to the Host!");
	static uint32_t timeCount = 0;

    int ret = 0;
	volatile bool channel1_flag = false;
	volatile bool channel2_flag = false;
	int16_t frame_buffer[PCM_BLOCK_SIZE] = {0};
	// int16_t frame_buffer1[FRAME_SIZE] = {0};
	// int16_t frame_buffer2[FRAME_SIZE] = {0};
    size_t data_out_size = 0;
     
    struct net_buf *buf_out;

	buf_out = net_buf_alloc(&pool_out, K_NO_WAIT);
	if (!buf_out) 
	{
		LOG_ERR("Failed to allocate data buffer");
	}

	// if(k_msgq_get(&audio_queue1, (int16_t*)buf_out->data, K_NO_WAIT) == 0)
	// {
	// 	channel1_flag = true;
	// }
#if 1
	if(switch_mic_flag)
	{
		/** Prioritize reading data from queue 1 */
		if(k_msgq_get(&audio_queue1, (int16_t*)buf_out->data, K_NO_WAIT) == 0)
		{
			channel1_flag = true;
			/** discard the old audio data of microphone 2 to leave room for new data */
			k_msgq_get(&audio_queue2, frame_buffer, K_NO_WAIT);
		}
		else if(k_msgq_get(&audio_queue2, (int16_t*)buf_out->data, K_NO_WAIT) == 0)
		{
			channel2_flag = true;
		}
	}
	else
	{
		/** Prioritize reading data from queue 2 */
		if(k_msgq_get(&audio_queue2, (int16_t*)buf_out->data, K_NO_WAIT) == 0)
		{
			channel2_flag = true;
			/** discard the old audio data of microphone 1 to leave room for new data */
			k_msgq_get(&audio_queue1, frame_buffer, K_NO_WAIT);
		}
		else if(k_msgq_get(&audio_queue1, (int16_t*)buf_out->data, K_NO_WAIT) == 0)
		{
			channel1_flag = true;
		}
	}
#endif 
   
#if (CONFIG_OPUS_CHANNELS==1)
    // LOG_HEXDUMP_INF(frame_buffer1, 8, "Receive audio queue");
	if(channel1_flag && channel2_flag)
	{
		LOG_INF("1 & 2\n");
		pcm_mix((int16_t*) frame_buffer1, sizeof(frame_buffer1), (int16_t*) frame_buffer1, sizeof(frame_buffer1), B_MONO_INTO_A_MONO);
		pcm_mix((int16_t*) frame_buffer2, sizeof(frame_buffer2), (int16_t*) frame_buffer2, sizeof(frame_buffer2), B_MONO_INTO_A_MONO);
		mono_to_stereo((int16_t*) frame_buffer1, (int16_t*) frame_buffer2, FRAME_SIZE, (int16_t*)buf_out->data);
	}
	else if(channel1_flag)
	{
		// LOG_INF("1\n");
		pcm_mix((int16_t*) frame_buffer1, sizeof(frame_buffer1), (int16_t*) frame_buffer1, sizeof(frame_buffer1), B_MONO_INTO_A_MONO);
		mono_to_stereo((int16_t*) frame_buffer1, (int16_t*) frame_buffer1, FRAME_SIZE, (int16_t*)buf_out->data);
	}
	else if(channel2_flag)
	{
		LOG_INF("2\n");
		// LOG_HEXDUMP_INF(frame_buffer2, 8, "Receive audio queue");
		pcm_mix((int16_t*) frame_buffer2, sizeof(frame_buffer2), (int16_t*) frame_buffer2, sizeof(frame_buffer2), B_MONO_INTO_A_MONO);
		mono_to_stereo((int16_t*) frame_buffer2, (int16_t*) frame_buffer2, FRAME_SIZE, (int16_t*)buf_out->data);
	}
	else
#endif
	if(!channel1_flag && !channel2_flag)
	{
		LOG_ERR("Both audio buffers are NULL");
		// net_buf_unref(buf_out);
		// return;
		memset(buf_out->data, 0, buf_out->size);
	}

	data_out_size =  buf_out->size;
	// LOG_INF("USB audio TX data size: %d", data_out_size);
#if 1
	 /** USB audio driver handle the pcm stream*/
	if (data_out_size == usb_audio_get_in_frame_size(dev)) 
	{
		ret = usb_audio_send(dev, buf_out, data_out_size);
		if (ret) {
			LOG_WRN("USB TX failed, ret: %d", ret);
			net_buf_unref(buf_out);
		}
		else
		{	
			if(0 == (timeCount++ % 50))
				leds_toggle(USB_AUDIO_LED);
			// LOG_INF("usb audio send %d bytes succeed!\t", data_out_size);
		}
	} 
    else 
#endif
    {
		// LOG_WRN("Wrong size write: %d", data_out_size);
		net_buf_unref(buf_out);
	}
}


static void feature_update(const struct device *dev,
			   const struct usb_audio_fu_evt *evt)
{
	LOG_DBG("Control selector %d for channel %d updated",
		evt->cs, evt->channel);
	switch (evt->cs) {
	case USB_AUDIO_FU_MUTE_CONTROL:
	default:
		break;
	}
}



static const struct usb_audio_ops mic_ops = {
	.data_request_cb = handle_audio_data,
	.feature_update_cb = feature_update,
};


/*********************************opus decoder*********************************************/

static void opus_decoder_configure(void)
{
        printk("opus_decoder_get_size() = %d\n", opus_decoder_get_size(m_opus_channels));        
        __ASSERT_NO_MSG(opus_decoder_get_size(m_opus_channels) <= sizeof(m_opus_decoder));
        __ASSERT_NO_MSG(opus_decoder_init(m_opus_decoder_state, CONFIG_AUDIO_SAMPLING_FREQUENCY, m_opus_channels) == OPUS_OK);
}



void audio_buffer_handle(void)
{
    int err = 0;
    struct audio_payload rx_payload;
	int16_t block_ptr[PCM_FRAME_BYTES];
	// 1ms buffer
    // int16_t slice_buf[FRAME_SIZE];

	if(k_msgq_get(&m_msgq_rx_payloads, &rx_payload, K_FOREVER) == 0)
    {
		uint16_t pcm_index = 0;
		int frame_size = 0;
		uint8_t devID = rx_payload.dev_id;
		// uint8_t devID = 1;		//just for test
		uint32_t packet_id = rx_payload.data[0] | (rx_payload.data[1] << 8) | (rx_payload.data[2] << 16) | (rx_payload.data[3] << 24);

        // LOG_INF("Packet received[%d] from %d, 0x%02x, 0x%02x, 0x%02x, 0x%02x  ", rx_payload.length,			
		// 		devID, rx_payload.data[0],rx_payload.data[1], rx_payload.data[2],rx_payload.data[3]);
	#if 1
		frame_size = opus_decode(m_opus_decoder_state, 
								&rx_payload.data[4], 
								CONFIG_AUDIO_FRAME_SIZE_BYTES, 
								block_ptr, 
								CONFIG_AUDIO_FRAME_SIZE_SAMPLES, 0);

		// LOG_INF("Dongle opus decoder:[%d]: %d--%d", devID, packet_id, frame_size);
		if(frame_size != CONFIG_AUDIO_FRAME_SIZE_SAMPLES)	
		{															
			LOG_INF("[%d]: %d--%d: 0x%02x, 0x%02x, 0x%02x, 0x%02x", packet_id, rx_payload.length, frame_size, rx_payload.data[0],
					rx_payload.data[1],rx_payload.data[MAX_PAYLOAD_SIZE-2],rx_payload.data[MAX_PAYLOAD_SIZE-1]);
			return;
		}

		/** send the PCM data to USB audio driver*/
		if(devID == MIC_ID1)
		{
			// LOG_INF("Dongle opus decoder:[%d]: %d--%d", devID, packet_id, frame_size);
			while(pcm_index + FRAME_SIZE <= frame_size * 2) // 2 channels
			{
				err = k_msgq_put(&audio_queue1, &block_ptr[pcm_index], K_MSEC(2));
				if(!err)
				{
					pcm_index += FRAME_SIZE;
				}
				else
				{
					LOG_ERR("1[%d] Message sent error: %d", pcm_index, err);
					break;
				}
			}
		}
		else if(devID == MIC_ID2)
		{	
			// LOG_INF("Dongle opus decoder:[%d]: %d--%d", devID, packet_id, frame_size);
			while(pcm_index + FRAME_SIZE <= frame_size * 2) // 2 channels
			{
				err = k_msgq_put(&audio_queue2, &block_ptr[pcm_index], K_NO_WAIT);			
				if(!err)
				{
					pcm_index += FRAME_SIZE;
				}
				else
				{
					LOG_ERR("2[%d] Message sent error: %d", pcm_index, err);
					break;
				}
			}
		}
		else
		{
			err = -EINVAL;
		}
	#endif
    } 
    else 
    {
        LOG_ERR("Error while reading esb rx packet");
    }
}

static void ble_audio_data_handle(void *, void *, void *)
{
	int ret;

	if (!device_is_ready(mic_dev)) {
		LOG_ERR("Device USB Microphone is not ready");
		return;
	}
	LOG_INF("Found USB Microphone Device");

	usb_audio_register(mic_dev, &mic_ops);

	ret = usb_enable(NULL);
	if (ret != 0) {
		LOG_ERR("Failed to enable USB");
		return;
	}

	opus_decoder_configure();

	LOG_INF("USB enabled");
	LOG_INF("mic_frame_size = %d\t ", usb_audio_get_in_frame_size(mic_dev));

    while(1)
    {
		audio_buffer_handle();
    }
}


K_THREAD_DEFINE(ble_audio_service, AUDIO_HANDLE_STACK_SIZE,
                ble_audio_data_handle, NULL, NULL, NULL,
                K_PRIO_PREEMPT(AUDIO_HANDLE_PRIORITY), 0, 0);
```

## src/usb_audio_handle.h
```c
#ifndef __USB_AUDIO_APP_H__
#define __USB_AUDIO_APP_H__

#include <stdint.h>
#include "opus_application_config.h"
#include "opus.h"

#define MAX_SAMPLE_RATE             16000
#define SAMPLE_BIT_WIDTH            16
#define BYTES_PER_SAMPLE            sizeof(int16_t)

// #define CONFIG_AUDIO_SAMPLE_RATE_HZ         16000
// #define CONFIG_AUDIO_BIT_DEPTH_OCTETS       2

#define USB_FRAME_SIZE_STEREO               (((MAX_SAMPLE_RATE * BYTES_PER_SAMPLE) / 1000) *2)

#define CONFIG_FIFO_FRAME_SPLIT_NUM         100




/* Size of a block for 1 ms of audio data. */
#define BLOCK_SIZE(_sample_rate, _number_of_ms) \
	(BYTES_PER_SAMPLE * (_sample_rate / 1000) * _number_of_ms)

// #define MAX_BLOCK_SIZE              (BLOCK_SIZE(MAX_SAMPLE_RATE, 1) * 5)	// 10 ms

#define PCM_BLOCK_SIZE				BLOCK_SIZE(MAX_SAMPLE_RATE, 2) 			// 1 ms
#define FRAME_SIZE                  ((MAX_SAMPLE_RATE / 1000) * 2)			// 1 ms

#define PCM_FRAME_BYTES 			(CONFIG_AUDIO_FRAME_SIZE_SAMPLES * CONFIG_OPUS_CHANNELS)


#define PCM_BLOCK_COUNT             100

#define MAX_PAYLOAD_SIZE			(160 + 4) // 160 bytes for Opus payload + 4 bytes for packet ID



/** @brief Enhanced ShockBurst payload.
 *
 *  The payload is used both for transmissions and for acknowledging a
 *  received packet with a payload.
 */
struct audio_payload {
    uint8_t dev_id; /**< Device ID, used to identify the device that sent the packet. */
	uint8_t length; /**< Length of the packet when not in DPL mode. */
	uint8_t data[MAX_PAYLOAD_SIZE]; /**< The payload data and devID. */
};


extern struct k_msgq m_msgq_rx_payloads;

#endif
```
